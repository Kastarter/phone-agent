## firmware/main/Kconfig.projbuild
```kconfig
menu "AgentMouse prototype"
    config AGENTMOUSE_DEMO_BATTERY_LEVEL
        int "Demo battery level (not an ADC measurement)"
        range 0 100
        default 100
        help
            Battery Service value for this USB-powered development prototype.
            Replace the constant with real battery measurement before battery use.
    config AGENTMOUSE_STATUS_RGB
        bool "Enable onboard WS2812 task RGB"
        depends on IDF_TARGET_ESP32S3
        default y
    config AGENTMOUSE_RGB_GPIO
        int "WS2812 data GPIO"
        depends on AGENTMOUSE_STATUS_RGB
        range 0 48
        default 48
    config AGENTMOUSE_RGB_BRIGHTNESS
        int "Peak LED brightness (1-255)"
        depends on AGENTMOUSE_STATUS_RGB
        range 2 255
        default 48
endmenu
```

## firmware/sdkconfig.defaults
```kconfig
CONFIG_BT_ENABLED=y
CONFIG_BT_BLUEDROID_ENABLED=n
CONFIG_BT_NIMBLE_ENABLED=y
CONFIG_BT_NIMBLE_MAX_CONNECTIONS=2
CONFIG_BT_NIMBLE_MAX_BONDS=3
CONFIG_BT_NIMBLE_MAX_CCCDS=8
CONFIG_BT_NIMBLE_NVS_PERSIST=y
CONFIG_BT_NIMBLE_SECURITY_ENABLE=y
CONFIG_BT_NIMBLE_ROLE_CENTRAL=n
CONFIG_BT_NIMBLE_ROLE_OBSERVER=n
CONFIG_BT_NIMBLE_ATT_PREFERRED_MTU=64
CONFIG_ESPTOOLPY_FLASHSIZE_8MB=y
CONFIG_FREERTOS_HZ=1000
CONFIG_IDF_TARGET="esp32s3"
# M5StickS3: GPIO48 is the shared I2C SCL (PMIC, IMU, codec); no WS2812 on board.
# CONFIG_AGENTMOUSE_STATUS_RGB is not set
```
